/*
 * Ym2149Synth
 * http://trash80.com
 * Copyright (c) 2016 Timothy Lamb
 *
 * This file is part of Ym2149Synth.
 *
 * Ym2149Synth is free software: you can redistribute it and/or modify
 * it under the terms of the GNU General Public License as published by
 * the Free Software Foundation, either version 3 of the License, or
 * (at your option) any later version.
 *
 * Ym2149Synth is distributed in the hope that it will be useful,
 * but WITHOUT ANY WARRANTY; without even the implied warranty of
 * MERCHANTABILITY or FITNESS FOR A PARTICULAR PURPOSE.  See the
 * GNU General Public License for more details.
 *
 * You should have received a copy of the GNU General Public License
 * along with Foobar.  If not, see <http://www.gnu.org/licenses/>.
 *
 */

 #include "SynthVoice.h"

/*
 *
 * ~~~~~ BEHOLD ALLMIGHTY JAVASCRIPT FOR TABLE GENERATION. ~~~
 * Run in a browser console.
 *
 * For YM pitch "freqTable":
 * function nf(n) {return Math.round((2000000.0/((Math.pow(2,(((n) - 69)/12)) * 440.0)))/16);};var out = [];for(var i =0; i<128; i += 0.1) out.push(nf(i));copy(out.toString());console.log("Data in copybuffer. Array size is "+out.length);
 *
 * For SoftSynth pitch "softFreqTable":
 * function nf(n) {return Math.round((Math.pow(2,(((n) - 69)/12)) * 440.0) * (1.0/22050) * 1000000) / 1000000;};var out = [];for(var i =0; i<128; i += 0.1) out.push(nf(i));copy(out.toString());console.log("Data in copybuffer. Array size is "+out.length);
 *
*/
//@TODO document this class
//@TODO resize these arrays to only include notes that are playable
const static uint16_t tableSize = 1281;
const static uint16_t freqTable[tableSize] = {
    15289,15201,15113,15026,14940,14854,14768,14683,14599,14515,14431,14348,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9
};

//@TODO fixed point, could be unsigned long
const static float softFreqTable[tableSize] = {
    0.000371,0.000373,0.000375,0.000377,0.000379,0.000382,0.000384,0.000386,0.000388,0.000391,0.000393,0.000395,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0.60271
};

void SynthVoice::begin(YM2149 * ym, uint8_t sy)
{
    Ym = ym;
    synth = sy;

    enableVoice = true;
    enableSoftsynth = true;

    Ym->setNoise(synth,0);
    Ym->setEnv(synth,0);
    volumeEnvelope.begin();
    pitchEnvelope.begin();

    volumeEnvelope.setShape(0x00);
    volumeEnvelope.setRange(0,31);

    pitchEnvelope.setShape(0x00);
    pitchEnvelope.setRange(0,255);

    synthType = 255;
    setSynthType(0);
}

void SynthVoice::updateSoftsynth()
{
    //@TODO optimize this, used fixed.h for fixed point math
    if(!enableSoftsynth || volume <= 0) {
        return;
    }

    softPhase += softIncrement;

    if(softPhase > 1) softPhase -= 1;
    if(softPhase < 0) softPhase += 1;

    if(softPhase >= softWidth) {
        if(softWavPos) {
            softWavPos = 0;
            Ym->setVolume(synth,volume);
        }
    } else {
        if(!softWavPos) {
            softWavPos = 1;
            Ym->setVolume(synth,0);
        }
    }
}

void SynthVoice::updateEvents()
{
    //@TODO optimize this, used fixed.h for fixed point math
    uint16_t f = currentFreq+transpose;

    if(playing) {
        if(glide && notePitch != currentFreq) {
            if(notePitch > currentFreq) {
                currentFreq += glideIncrement;
                if(currentFreq > notePitch) currentFreq = notePitch;
                f = currentFreq+transpose;
            } else if(notePitch < currentFreq) {
                currentFreq -= glideIncrement;
                if(currentFreq < notePitch) currentFreq = notePitch;
                f = currentFreq+transpose;
            }
        }

        if(vibratoAmount && currentFreq) {
            vibratoPhase += vibratoIncrement;
            if(vibratoPhase > 1) vibratoPhase -= 2;
            if(vibratoPhase < -1) vibratoPhase += 2;
            f += (((abs(vibratoPhase) * 2) - 1) * vibratoAmount);
        }

        if(pitchEnvAmount) {
            pitchEnvelope.update();
            float envAmt = pitchEnvelope.read();
            envAmt /=255.0f;
            if(pitchEnvelope.getShape() & 0x80) {
                envAmt *= pitchEnvAmount * 10;
            } else {
                envAmt = (1.0f - envAmt) * pitchEnvAmount * -10;
            }
            f += envAmt;
        }

        if(bendWheel) {
            f += (bendWheel * 10);
        }

        if(f != lastNoteFreq) {
            lastNoteFreq = f;

            if(enableSoftsynth) {
                uint16_t sf = f;
                if(enableSoftDetune) sf +=pwmFreq+softFreqDetune;
                if(sf>=tableSize) sf = tableSize-1;
                softIncrement = softFreqTable[sf];
            }

            if(enableVoice) {
                Ym->setTone(synth,freqTable[f]);
            }
            if(enableEnv) {
                Ym->setTone(4,freqTable[f+pwmFreq]);
            }
            if (enableNoise || noiseDelayTriggered) {
                Ym->setTone(3,0x1F - ((uint8_t)(f/10)>>2));
            }
        }

        if(volumeEnvelope.update()) {
            volume = volumeEnvelope.read();
            if(volume == 0 && volumeEnvelope.getShape() & 0x80) {
                playing = false;
            }
            Ym->setVolume(synth,volume);
        }

        if(noiseDelay && !noiseDelayTriggered) {
            noiseDelayPhase += noiseDelayIncrement;
            if(noiseDelayPhase >= 1) {
                noiseDelayPhase = 0;
                noiseDelayTriggered = true;
                if(!enableNoise) {
                    Ym->setNoise(synth,1);
                } else {
                    Ym->setNoise(synth,0);
                }
            }
        }
    }
}

void SynthVoice::playNote(uint8_t n, uint8_t v)
{
    //@TODO refactor this
    //@TODO use a new note buffer class for handling monophonic note behavior
    if(v) {
        velocity = v;
        note     = n;
        notePitch = ((uint16_t)n)*10;
        if(playing == false) {
            volumeEnvelope.reset();
            volumeEnvelope.setRange(0,v>>3);
            currentFreq = notePitch;
            volume = -1;
        } else {
            if(glide) {
                glideIncrement = abs(((int)notePitch) - currentFreq);
                glideIncrement *= glide;
            } else {
                glideIncrement = 0;
                currentFreq = notePitch;
            }
        }

        pitchEnvelope.reset();

        if(softIncrement > 1) softIncrement = 1;
        if(softIncrement < 0) softIncrement = 0;

        if(!enableVoice) {
            Ym->setNote(synth,255);
        }

        if(enableNoise) {
            Ym->setNoise(synth,1);
        } else {
            noiseDelayTriggered = false;
            enableNoise = false;
            Ym->setNoise(synth,0);
        }
        noiseDelayPhase = 0;

        if(enableEnv) {
            Ym->setEnv(synth,1);
            Ym->setEnvShape(0,0,0,0);
            if(envType == 1) {
                Ym->setEnvShape(1,0,0,0);
            } else {
                Ym->setEnvShape(1,0,1,0);
            }
        }

        playing = true;
        lastNoteFreq = 0;
    } else if(n == note) {
        playing = false;
        volume = 0;
        if(enableEnv) {
            Ym->setEnv(synth,0);
        }
        Ym->setVolume(synth,0);
    }
}

void SynthVoice::setPitchbend(int v)
{
    bendWheel = v;
    bendWheel /= 0x2000;
    bendWheel *= 2;
}

void SynthVoice::setGlide(uint8_t v)
{
    unsigned int ms = map(v, 0, 127, 0, 1000);
    glide = 1.0f/ms;
}

void SynthVoice::setVolumeEnvShape(uint8_t v)
{
    if(v == 64) v = 65;
    volumeEnvelope.setShape(v);
}

void SynthVoice::setPitchEnvShape(uint8_t v)
{
    pitchEnvelope.setShape(v);
}

void SynthVoice::setPitchEnvAmount(uint8_t v)
{
    pitchEnvAmount = v;
}

void SynthVoice::setVibratoAttack(uint8_t v)
{
    unsigned int ms = map(v, 0, 127, 0, 1000);
    vibratoDelayIncrement = 1.0f/ms;
}

void SynthVoice::setVibratoAmount(uint8_t v)
{
    vibratoAmount = v;
}

void SynthVoice::setVibratoFreq(uint8_t v)
{
    unsigned int ms = (pow(8000.0f,1.0f - ((float)v)/127.0f)) + 5;
    vibratoIncrement = 1.0f/ms;
}

void SynthVoice::setPwmFreq(uint8_t v)
{
    pwmFreq = v;

    if(synthType == 6) {
        softWidth = ((float)(pwmFreq)/255) + 0.5;
    }
    if(playing) {
        lastNoteFreq = 0;
    }
}

void SynthVoice::setSoftDetune(uint8_t v)
{
    softFreqDetune = v;
    softFreqDetune *= 10;
    if(playing) {
        lastNoteFreq = 0;
    }
}

void SynthVoice::setNoiseDelay(uint8_t v)
{
    noiseDelay = v;
    unsigned int ms = (pow(4000.0f,((float)v)/127.0f)) + 5;
    noiseDelayIncrement = 1.0f/ms;
}

void SynthVoice::setTranspose(uint8_t v)
{
    if(!v) v = 64;
    transpose = (((int)v) - 64) * 10;
}

void SynthVoice::setSynthType(uint8_t v)
{
    if(v == synthType) return;

    synthType = v;

    if(enableNoise) Ym->setNoise(synth,0);
    if(enableEnv) Ym->setEnv(synth,0);

    enableVoice = false;
    enableSoftsynth = false;
    enableEnv   = false;
    envType     = 0;
    enableNoise = false;
    enableSoftDetune = false;
    softShape   = 1;

    switch(synthType)
    {
        case 0:
            enableVoice = true;
        break;
        case 1:
            enableVoice = true;
            enableEnv   = true;
            envType     = 1;
        break;
        case 2:
            enableVoice = true;
            enableEnv   = true;
            envType     = 2;
        break;
        case 3:
            enableVoice = false;
            enableEnv   = true;
            envType     = 2;
        break;
        case 4:
            enableVoice = false;
            enableEnv   = true;
            envType     = 1;
        break;
        case 5:
            enableVoice = true;
            enableSoftsynth = true;
            enableSoftDetune  = true;
            softWidth = 0.5;
            softShape = 1;
        break;
        case 6:
            enableSoftsynth = true;
            softWidth = ((float)(pwmFreq)/255) + 0.5;
        break;
        case 7:
            enableNoise = true;
        break;
        default:
            enableVoice = true;
        break;
    }
    if(playing) {
        lastNoteFreq = 0;
        playing = false;
        playNote(note, velocity);
    }
}
